## shield/dgrim/Kconfig.defconfig
```kconfig
## for dongle (left => dongle)
if SHIELD_dgrim_DONGLE        

config ZMK_KEYBOARD_NAME
    default "dgrim"

config ZMK_SPLIT_ROLE_CENTRAL
    default y
  
# for dongle
config ZMK_USB        
    default y

endif
  
## for dongle (add dongle and etc)
if SHIELD_dgrim_DONGLE || SHIELD_dgrim_LEFT || SHIELD_dgrim_RIGHT || SHIELD_dgrim_PAD    

config ZMK_SPLIT
    default y
  
# for dongle
config ZMK_BLE    
    default y

if ZMK_DISPLAY

config I2C
    default y

config SSD1306
    default y

endif # ZMK_DISPLAY
```

## shield/dgrim/Kconfig.shield
```kconfig
# Copyright (c) 2023 The ZMK Contributors
# SPDX-License-Identifier: MIT

config SHIELD_dgrim_DONGLE
    def_bool $(shields_list_contains,dgrim_dongle)

config SHIELD_dgrim_LEFT
    def_bool $(shields_list_contains,dgrim_left)

config SHIELD_dgrim_RIGHT
    def_bool $(shields_list_contains,dgrim_right)

config SHIELD_dgrim_PAD
    def_bool $(shields_list_contains,dgrim_pad)
```
